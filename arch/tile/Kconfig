## arch/tile/Kconfig
```kconfig
# SPDX-License-Identifier: GPL-2.0
# For a description of the syntax of this configuration file,
# see Documentation/kbuild/kconfig-language.rst.
#
# Forward-port note: TILEPro support was dropped in this port (TILE-Gx only,
# matching the GCC/glibc revival). KVM, NUMA/discontigmem, and kexec are
# deferred from the first-compile scope.

config ARCH_SUPPORTS_KEXEC
	def_bool y

config TILE
	def_bool y
	select ARCH_HAS_DEVMEM_IS_ALLOWED
	select ARCH_HAS_DMA_ALLOC
	select ARCH_HAS_DMA_SET_MASK if PCI
	select ARCH_HAS_PHYS_TO_DMA
	select ARCH_HAS_SYNC_DMA_FOR_CPU
	select ARCH_HAS_SYNC_DMA_FOR_DEVICE
	select ARCH_HAVE_NMI_SAFE_CMPXCHG
	select ARCH_NEED_CMPXCHG_1_EMU
	select ARCH_WANT_FRAME_POINTERS
	select EDAC_SUPPORT
	select GENERIC_PCI_IOMAP if PCI
	select GENERIC_IRQ_PROBE
	select GENERIC_IRQ_SHOW
	select GENERIC_PENDING_IRQ if SMP
	select GENERIC_STRNCPY_FROM_USER
	select GENERIC_STRNLEN_USER
	select HAVE_ARCH_SECCOMP_FILTER
	select HAVE_ARCH_TRACEHOOK
	select HAVE_DEBUG_BUGVERBOSE
	select HAVE_DEBUG_KMEMLEAK
	select HAVE_DEBUG_STACKOVERFLOW
	select HAVE_EXIT_THREAD
	select HAVE_NMI if USE_PMC
	select HAVE_PCI
	select HAVE_PERF_EVENTS
	select HAVE_SYSCALL_TRACEPOINTS
	select KALLSYMS_ABSOLUTE if KALLSYMS
	select MODULES_USE_ELF_RELA
	select NEED_SG_DMA_LENGTH
	select PCI_DOMAINS if PCI
	select PCI_MSI_ARCH_FALLBACKS if PCI_MSI
	select SWIOTLB
	select SYSCTL_EXCEPTION_TRACE
	select SYS_HYPERVISOR
	select TILE_GXIO_TRIO if PCI
	select USER_STACKTRACE_SUPPORT
	select USE_PMC if PERF_EVENTS
	select HAVE_PAGE_SIZE_16KB
	select HAVE_PAGE_SIZE_64KB

config MMU
	def_bool y

# The Gx memory controllers hand out 2^38-strided discontiguous PA
# ranges, so a flat mem_map can only reach controller 0; sparse
# sections cover all of them without needing NUMA.
config ARCH_SPARSEMEM_ENABLE
	def_bool y

config GENERIC_CSUM
	def_bool y

config HAVE_ARCH_ALLOC_REMAP
	def_bool y

config HAVE_SETUP_PER_CPU_AREA
	def_bool y

config NEED_PER_CPU_PAGE_FIRST_CHUNK
	def_bool y

config SYS_SUPPORTS_HUGETLBFS
	def_bool y

# Support for additional huge page sizes besides HPAGE_SIZE.
# The software support is currently only present in the TILE-Gx
# hypervisor.
config HUGETLB_SUPER_PAGES
	depends on HUGETLB_PAGE && TILEGX
	def_bool y

config GENERIC_TIME_VSYSCALL
	def_bool y

# Enable PMC if PERF_EVENTS, OPROFILE, or WATCHPOINTS are enabled.
config USE_PMC
	bool

config LOCKDEP_SUPPORT
	def_bool y

config STACKTRACE_SUPPORT
	def_bool y

config TRACE_IRQFLAGS_SUPPORT
	def_bool y

# SMP is required for Tilera Linux.
config SMP
	def_bool y

config HVC_TILE
	depends on TTY
	select HVC_DRIVER
	select HVC_IRQ if TILEGX
	def_bool y

# This port is TILE-Gx only; the 64-bit toolchain is assumed.
config TILEGX
	def_bool y
	select ARCH_SUPPORTS_ATOMIC_RMW
	select HAVE_ARCH_JUMP_LABEL
	select HAVE_ARCH_KGDB
	select HAVE_DYNAMIC_FTRACE
	select HAVE_FTRACE_MCOUNT_RECORD
	select HAVE_FUNCTION_GRAPH_TRACER
	select HAVE_FUNCTION_TRACER
	select HAVE_KPROBES
	select HAVE_KRETPROBES
	select SPARSE_IRQ

config 64BIT
	def_bool TILEGX

config PGTABLE_LEVELS
	int
	default 3 if 64BIT
	default 2

menu "Tilera-specific configuration"

config NR_CPUS
	int "Maximum number of tiles (2-255)"
	range 2 255
	depends on SMP
	default "64"
	help
	  Building with 64 is the recommended value, but a slightly
	  smaller kernel memory footprint results from using a smaller
	  value on chips with fewer tiles.

source "kernel/Kconfig.hz"

config COMPAT
	bool "Support 32-bit TILE-Gx binaries in addition to 64-bit"
	depends on TILEGX
	select COMPAT_BINFMT_ELF
	default y
	help
	  If enabled, the kernel will support running TILE-Gx binaries
	  that were built with the -m32 option.

config SYSVIPC_COMPAT
	def_bool y
	depends on COMPAT && SYSVIPC

config ZONE_DMA32
	def_bool y

config CMDLINE_BOOL
	bool "Built-in kernel command line"
	default n
	help
	  Allow for specifying boot arguments to the kernel at
	  build time.  On some systems (e.g. embedded ones), it is
	  necessary or convenient to provide some or all of the
	  kernel boot arguments with the kernel itself (that is,
	  to not rely on the boot loader to provide them.)

	  To compile command line arguments into the kernel,
	  set this option to 'Y', then fill in the
	  the boot arguments in CONFIG_CMDLINE.

	  Systems with fully functional boot loaders (e.g. mboot, or
	  if booting over PCI) should leave this option set to 'N'.

config CMDLINE
	string "Built-in kernel command string"
	depends on CMDLINE_BOOL
	default ""
	help
	  Enter arguments here that should be compiled into the kernel
	  image and used at boot time.  If the boot loader provides a
	  command line at boot time, it is appended to this string to
	  form the full kernel command line, when the system boots.

	  However, you can use the CONFIG_CMDLINE_OVERRIDE option to
	  change this behavior.

	  In most cases, the command line (whether built-in or provided
	  by the boot loader) should specify the device for the root
	  file system.

config CMDLINE_OVERRIDE
	bool "Built-in command line overrides boot loader arguments"
	default n
	depends on CMDLINE_BOOL
	help
	  Set this option to 'Y' to have the kernel ignore the boot loader
	  command line, and use ONLY the built-in command line.

	  This is used to work around broken boot loaders.  This should
	  be set to 'N' under normal conditions.

config VMALLOC_RESERVE
	hex
	default 0x2000000

config HARDWALL
	bool "Hardwall support to allow access to user dynamic network"
	default y

config KERNEL_PL
	int "Processor protection level for kernel"
	range 1 2
	default 2 if TILEGX
	default 1 if !TILEGX
	help
	  Since MDE 4.2, the Tilera hypervisor runs the kernel
	  at PL2 by default.  If running under an older hypervisor,
	  or as a KVM guest, you must run at PL1.  (The current
	  hypervisor may also be recompiled with "make HV_PL=2" to
	  allow it to run a kernel at PL1, but clients running at PL1
	  are not expected to be supported indefinitely.)

	  If you're not sure, don't change the default.

source "arch/tile/gxio/Kconfig"

endmenu  # Tilera-specific configuration

menu "Bus options"

config NO_IOMEM
	def_bool !PCI

config NO_IOPORT_MAP
	def_bool !TILE_PCI_IO

config TILE_USB
	bool "Tilera USB host adapter support"
	default y
	depends on USB
	select TILE_GXIO_USB_HOST
	help
	  Provides USB host adapter support for the built-in EHCI and OHCI
	  interfaces on TILE-Gx chips.

config TILE_PCI_IO
	bool "PCI I/O space support"
	depends on PCI
	help
	  Enable PCI I/O space support on TILE-Gx. Since the PCI I/O space
	  is used by few modern PCIe endpoint devices, its support is disabled
	  by default to save the TRIO PIO Region resource for other purposes.

endmenu
```
